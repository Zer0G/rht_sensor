## main/Kconfig.projbuild
```kconfig
menu "RHT sensor configuration"

config RHT_WIFI_SSID
    string "Wi-Fi SSID"
    default ""

config RHT_WIFI_PASSWORD
    string "Wi-Fi password"
    default ""

config RHT_MQTT_URI
    string "MQTT broker URI"
    default "mqtt://192.168.2.99:1883"

config RHT_MQTT_USERNAME
    string "MQTT username"
    default ""

config RHT_MQTT_PASSWORD
    string "MQTT password"
    default ""

config RHT_MQTT_BASE_TOPIC
    string "MQTT base topic"
    default "homeassistant/sensor/rht_epaper"

config RHT_OTA_MANIFEST_URL
    string "GitHub OTA manifest URL"
        default "https://github.com/zer0g/climacarta/releases/latest/download/manifest.json"
    help
        Public HTTPS URL of the GitHub Releases manifest. The manifest must
        contain version, url, and sha256 string fields.

config RHT_DEVICE_ID
    string "Home Assistant device id"
    default "rht_epaper"

config RHT_NTP_SERVER
    string "NTP server"
    default "pool.ntp.org"

config RHT_TIMEZONE
    string "POSIX timezone"
    default "CET-1CEST,M3.5.0,M10.5.0/3"

config RHT_T_SAMPLE
    int "t_sample: sampling interval in seconds"
    range 10 86400
    default 900
    help
        Interval between sensor readings and statistics updates. While an
        active USB host is connected, the device stays awake and keeps the
        command console available.

config RHT_UPDATE_FREQ
    int "update_freq: MQTT update multiplier"
    range 0 10080
    default 1
    help
        Number of t_sample intervals between Wi-Fi/MQTT updates. Values 0 and
        1 publish every sample, 2 every two samples, and so on.

config RHT_TEMP_OFFSET_C_X100
    int "SHTC3 temperature calibration offset, hundredths C"
    range -1000 1000
    default 0

config RHT_NTP_RESYNC_HOURS
    int "Maximum interval between NTP synchronizations"
    range 1 168
    default 24

endmenu
```

## sdkconfig.defaults
```kconfig
CONFIG_IDF_TARGET="esp32c6"
CONFIG_ESPTOOLPY_FLASHMODE_QIO=y
CONFIG_ESPTOOLPY_FLASHSIZE_16MB=y
CONFIG_PARTITION_TABLE_CUSTOM=y
CONFIG_PARTITION_TABLE_CUSTOM_FILENAME="partitions.csv"
CONFIG_COMPILER_OPTIMIZATION_SIZE=y
CONFIG_LIBC_TIME_SYSCALL_USE_RTC_HRT=y
CONFIG_LWIP_SNTP_MAX_SERVERS=2
CONFIG_ESP_WIFI_SLP_DEFAULT_MIN_ACTIVE_TIME=50
CONFIG_ESP_WIFI_SLP_DEFAULT_MAX_ACTIVE_TIME=10
CONFIG_RHT_T_SAMPLE=900
CONFIG_RHT_UPDATE_FREQ=1
CONFIG_RHT_TEMP_OFFSET_C_X100=0
CONFIG_RHT_MQTT_URI="mqtt://192.168.2.99:1883"
CONFIG_RHT_OTA_MANIFEST_URL="https://github.com/zer0g/climacarta/releases/latest/download/manifest.json"
CONFIG_APP_PROJECT_VER_FROM_CONFIG=y
CONFIG_APP_PROJECT_VER="v0.1.0"
CONFIG_BOOTLOADER_APP_ROLLBACK_ENABLE=y
CONFIG_MBEDTLS_CERTIFICATE_BUNDLE=y
CONFIG_MBEDTLS_CERTIFICATE_BUNDLE_DEFAULT_FULL=y
```
